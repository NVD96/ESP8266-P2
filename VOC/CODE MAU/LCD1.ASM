#include <sfr52.inc>
ORG 00H
MOV A,#38H
ACALL GUIDI
ACALL TRE
;
MOV A,#0EH
ACALL GUIDI
ACALL TRE
;
MOV A,#01H
ACALL GUIDI
ACALL TRE 
;
MOV A,#1CH
ACALL GUIDI
ACALL TRE
;Hien hang 1
MOV A,#81H
ACALL GUIDI
ACALL TRE
;
MOV A,#'C'
ACALL HIENTHI
ACALL TRE
;
MOV A,#'u'
ACALL HIENTHI 
ACALL TRE
;
MOV A,#'o'
ACALL HIENTHI
ACALL TRE
;
MOV A,#'n'
ACALL HIENTHI
ACALL TRE
;
MOV A,#'g'
ACALL HIENTHI
ACALL TRE

MOV A,#'H'
ACALL HIENTHI
ACALL TRE
;
MOV A,#'a'
ACALL HIENTHI
ACALL TRE
;
MOV A,#'Q'
ACALL HIENTHI
ACALL TRE
;
MOV A,#'u'
ACALL HIENTHI
ACALL TRE
;
MOV A,#'a'
ACALL HIENTHI
ACALL TRE
;
MOV A,#'n'
ACALL HIENTHI
ACALL TRE
;
MOV A,#'T'
ACALL HIENTHI
ACALL TRE
MOV A,#'u'
ACALL HIENTHI
ACALL TRE
;
MOV A,#'a'
ACALL HIENTHI
ACALL TRE
;
MOV A,#'n'
ACALL HIENTHI
ACALL TRE
;
;
;Hien hang 2
MOV A,#0C1H
ACALL GUIDI
ACALL TRE
;
MOV R0,#2
LAP1:
MOV A,#'N'
ACALL HIENTHI
ACALL TRE
;
MOV A,#'g'
ACALL HIENTHI
ACALL TRE
;
MOV A,#'a'
ACALL HIENTHI
ACALL TRE
;
MOV A,#'u'
ACALL HIENTHI
ACALL TRE
;
MOV A,#'P'
ACALL HIENTHI
ACALL TRE
;
MOV A,#'i'
ACALL HIENTHI
ACALL TRE
;
MOV A,#'n'
ACALL HIENTHI
ACALL TRE

MOV A,#' '
ACALL HIENTHI
ACALL TRE
;
;
DJNZ R0,LAP1
;Hien xong hang 2

MOV A,#07H
ACALL GUIDI
ACALL TRE 

;
AGAIN :SJMP AGAIN
;
GUIDI:  MOV P1,A
        CLR P2.0
        CLR P2.1
	SETB P2.2
	CLR P2.2
	RET
;
HIENTHI:MOV P1,A
	SETB P2.0
	CLR P2.1
	SETB P2.2
	CLR P2.2
	RET
;
TRE:MOV R3,#50
HERE1:MOV R4,#255
HERE2:DJNZ R4,HERE2
      DJNZ R3,HERE1
      RET
END    	        	 